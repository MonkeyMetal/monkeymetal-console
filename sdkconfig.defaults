## sdkconfig.defaults
```kconfig
# MonkeyMetal Console - sdkconfig.defaults
#
# Target: ESP32-S3 dual-core LX7 @240MHz, 8MB Octal PSRAM, 16MB Flash QIO.
# Read by `idf.py reconfigure` to seed sdkconfig with project defaults.

CONFIG_IDF_TARGET="esp32s3"

# Flash
CONFIG_ESPTOOLPY_FLASHMODE_QIO=y
CONFIG_ESPTOOLPY_FLASHSIZE_16MB=y

# Custom partition table (factory + storage)
CONFIG_PARTITION_TABLE_CUSTOM=y
CONFIG_PARTITION_TABLE_CUSTOM_FILENAME="partitions.csv"

# 8 MB Octal PSRAM @80 MHz - intermediate framebuffers, Lua heap,
# game asset cache, audio mixer buffers, etc.
CONFIG_SPIRAM=y
CONFIG_SPIRAM_MODE_OCT=y
CONFIG_SPIRAM_SPEED_80M=y
CONFIG_SPIRAM_USE_MALLOC=y

# Allow BSS / NOINIT to live in PSRAM (handy for large engine globals)
CONFIG_SPIRAM_ALLOW_BSS_SEG_EXTERNAL_MEMORY=y
CONFIG_SPIRAM_ALLOW_NOINIT_SEG_EXTERNAL_MEMORY=y

# FreeRTOS @1kHz tick, dual core
CONFIG_FREERTOS_HZ=1000
CONFIG_FREERTOS_UNICORE=n

# Speed over size for the engine
CONFIG_COMPILER_OPTIMIZATION_PERF=y

# Long filenames + UTF-8 on FAT (Chinese game / save names)
CONFIG_FATFS_LFN_HEAP=y
CONFIG_FATFS_API_ENCODING_UTF_8=y

# Bigger main task stack for engine init paths
CONFIG_ESP_MAIN_TASK_STACK_SIZE=8192

# Quieter watchdog during dev
CONFIG_ESP_TASK_WDT_INIT=n

# ── Bluetooth (M5: BLE HID Host) ──────────────────────────────────────────
CONFIG_BT_ENABLED=y
CONFIG_BT_CONTROLLER_ENABLED=y
CONFIG_BT_BLUEDROID_ENABLED=y
CONFIG_BT_BLE_ENABLED=y
CONFIG_BT_CLASSIC_ENABLED=n
CONFIG_BT_BLE_42_FEATURES_SUPPORTED=y
CONFIG_BT_ACL_CONNECTIONS=2
CONFIG_BT_ALLOCATION_FROM_SPIRAM_FIRST=y
CONFIG_BT_BLE_DYNAMIC_ENV_MEMORY=y
```
